## meta-axelera/conf/distro/voyager.conf
```bitbake
# This is an example distro conf. Here is where you can customize the
# policies about how your embedded Linux system should be
# configured. Writing one is so simple that it does not make sense to not
# do it.

DISTRO_NAME = "Voyager,axelera Linux"
DISTRO_VERSION = "1.0"

# Set features we want on all AXELERA devices. Also disables any features not
# explicitly mentioned.
DISTRO_FEATURES = " \
  egl \
  ipv4 \
  ipv6 \
  opengl \
  pam \
  systemd \
  usbgadget \
  usbhost \
  vulkan \
  wayland \
  wifi \
  zeroconf \
"
```

## meta-axelera/conf/layer.conf
```bitbake
# We have a conf and classes directory, add to BBPATH
BBPATH .= ":${LAYERDIR}"

# We have recipes-* directories, add to BBFILES
BBFILES += "${LAYERDIR}/recipes-*/*/*.bb \
            ${LAYERDIR}/recipes-*/*/*.bbappend"

BBFILE_COLLECTIONS += "axelera"
BBFILE_PATTERN_axelera = "^${LAYERDIR}/"
BBFILE_PRIORITY_axelera = "99"

LAYERDEPENDS_axelera = "core rockchip virtualization-layer"

# This should only be incremented on significant changes that will
# cause compatibility issues with other layers
LAYERVERSION_axelera = "1"
LAYERSERIES_COMPAT_axelera = "kirkstone"
```

## meta-axelera/conf/machine/antelao-3588.conf
```bitbake
# Machine configuration for the Antelao product.
require conf/machine/include/axelera-base.inc

KERNEL_DEVICETREE = "rockchip/rk3588-antelao-axe-sbc.dtb"
KBUILD_DEFCONFIGS ?= "rk3588_linux_defconfig"
UBOOT_MACHINE = "rk3588_antelao_defconfig"
WESTON_USER = "antelao"

# Change to your device type.
MENDER_DEVICE_TYPE ?= "antelao-3588"
```

## meta-axelera/conf/machine/antelao-3588j.conf
```bitbake
# Machine configuration for the Firefly ITX-RK3588J product.

require conf/machine/include/rk3588.inc

PREFERRED_VERSION_linux-rockchip = "6.1%"
LINUXLIBCVERSION = "6.1-custom%"
SERIAL_CONSOLES = "115200;ttyFIQ0"

KERNEL_DEVICETREE = "rockchip/rk3588-antelao-axe-sbc.dtb"

KBUILD_DEFCONFIGS := "rockchip_linux_defconfig rk3588_linux.config firefly-linux.config"

UBOOT_MACHINE = "rk3588_defconfig firefly-linux.config"
```

## meta-axelera/conf/machine/axe-sbc.conf
```bitbake
#@TYPE: Machine
#@NAME: Axelera AXE-SBC-RK3588
#@DESCRIPTION: AXE-SBC-RK3588, the Metis Compute Board, is an SBC designed by Axelera AI.
#https://axelera.ai/evaluation-systems/metis-compute-board

require conf/machine/include/rk3588.inc

KERNEL_DEVICETREE = "rockchip/rk3588-axe-sbc.dtb"
MACHINE_EXTRA_RRECOMMENDS += "kernel-modules"

UBOOT_MACHINE = "axe-sbc-rk3588_defconfig"
PREFERRED_PROVIDER_virtual/kernel = "linux-axelera-mainline"
PREFERRED_PROVIDER_virtual/bootloader = "u-boot"
PREFERRED_VERSION_u-boot = "2026.01"
```

## meta-axelera/conf/machine/firefly-rk3588.conf
```bitbake
# Machine configuration for the Firefly Rk3588J product.
#
require conf/machine/include/axelera-base.inc

KERNEL_DEVICETREE = "rockchip/rk3588-evb1-lp4-v10-linux.dtb"
UBOOT_MACHINE = "rk3588_defconfig"

# Change to your device type.
MENDER_DEVICE_TYPE ?= "firefly-rk3588"
```

## meta-axelera/conf/machine/include/axelera-base.inc
```bitbake
# Machine configuration for the Firefly ITX-RK3588J product.
require conf/machine/include/rk3588.inc

PREFERRED_VERSION_linux-rockchip = "6.1%"
LINUXLIBCVERSION = "6.1-custom%"
SERIAL_CONSOLES = "115200;ttyFIQ0"

WKS_FILE = "voyager-gptdisk.wks.in"
WKS_FILE_CHECKSUM = "sha256:6f4ca85eb6a09bb4ff244f1cfe7029f52215a230780533658b8b7357f67f877a"

# /etc overlayfs configuration
OVERLAYFS_ETC_MOUNT_POINT = "/data"
OVERLAYFS_ETC_DEVICE = "/dev/mmcblk0p6"
OVERLAYFS_ETC_FSTYPE ?= "ext4"
OVERLAYFS_ETC_MOUNT_OPTIONS = "defaults,noatime"
OVERLAYFS_ETC_INIT_TEMPLATE = "${TOPDIR}/../meta-axelera/meta/files/overlayfs-etc-preinit.sh.in"
OVERLAYFS_ETC_USE_ORIG_INIT_NAME = "0"
```

## meta-axelera/conf/machine/include/mender.inc
```bitbake
#############################
# Mender-specific settings.
#############################

BOOTENV_SIZE = "0x20000"
MENDER_UBOOT_ENV_STORAGE_DEVICE_OFFSET_1 = "0x5400000"
MENDER_UBOOT_ENV_STORAGE_DEVICE_OFFSET_2 = "0x5420000"
MENDER_UBOOT_STORAGE_INTERFACE = "mmc"
MENDER_UBOOT_STORAGE_DEVICE = "0"
MENDER_ROOTFS_PART_A_NUMBER = "6"
MENDER_ROOTFS_PART_B_NUMBER = "7"
MENDER_DATA_PART_SIZE_MB = "128"
AXELERA_MENDER_FACTORY_PART_SIZE_MB = "128"

# Total size for BOTH partitions. 4096 == 2048 Megabytes (2 Gigabytes) per rootfs.
MENDER_STORAGE_TOTAL_SIZE_MB = "4096"

# Do not add padding.
IMAGE_OVERHEAD_FACTOR = "1.0"

# There is an fstab provided in recipes-core/base-files/files/
ROOTFS_POSTPROCESS_COMMAND:remove = "mender_update_fstab_file;"

# Data partition
MENDER_DATA_PART_NUMBER ?= "9"
```

## meta-axelera/conf/machine/itx-3588j.conf
```bitbake
# Machine configuration for the Firefly ITX-RK3588J product.
require conf/machine/include/axelera-base.inc

KERNEL_DEVICETREE = "rockchip/rk3588-firefly-itx-3588j-mipi101-M101014-BE45-A1.dtb"

KBUILD_DEFCONFIGS := "rockchip_linux_defconfig rk3588_linux.config firefly-linux.config"

UBOOT_MACHINE = "itx-3588j_defconfig"

WESTON_USER = "firefly"

# Change to your device type.
MENDER_DEVICE_TYPE ?= "itx-3588j"
```

## meta-axelera/meta-voyager/conf/distro/include/mender-config.inc
```bitbake
DISTROOVERRIDES:append = ":mender-systemd"
INHERIT:append = " mender-full"

# Mender creates an image for the data partition with a bootstrap file.
IMAGE_FSTYPES:append = " dataimg factoryimg"
MENDER_FEATURES_ENABLE:append = " mender-uboot mender-growfs-data"
MENDER_FEATURES_DISABLE:append = " mender-grub mender-image-uefi mender-auth-install"

MENDER_ARTIFACT_NAME = "voyager-${DISTRO_VERSION}"

IMAGE_TYPEDEP:wic:append = " dataimg factoryimg mender"
```

## meta-axelera/meta-voyager/conf/distro/voyager-minimal.conf
```bitbake
DISTRO_NAME = "Voyager Linux Minimal"
DISTRO_VERSION = "0.0.1"
SDK_NAME_PREFIX = "voyager-minimal"
SDK_VENDOR = "-voyagerminimalsdk"
SDK_VERSION := "${@'${DISTRO_VERSION}'.replace('snapshot-${METADATA_REVISION}','snapshot')}"
SDK_VERSION[vardepvalue] = "${SDK_VERSION}"
MAINTAINER = "Amarula Solutions <info@amarulasolutions.com>"
TARGET_VENDOR = "-voyagerminimal"

# Set features we want on all AXELERA devices. Also disables any features not
# explicitly mentioned.
DISTRO_FEATURES = " \
  egl \
  ipv4 \
  ipv6 \
  opengl \
  pam \
  seccomp \
  systemd \
  usbgadget \
  usbhost \
  wayland \
  wifi \
  x11 \
  zeroconf \
"

LICENSE_FLAGS_ACCEPTED:append = " commercial"

DISTRO_FEATURES_OPTED_OUT += "sysvinit"
VIRTUAL-RUNTIME_init_manager = "systemd"
VIRTUAL-RUNTIME_initscripts = "systemd-compat-units"

PREFERRED_PROVIDER_virtual/egl = "mesa"
PREFERRED_PROVIDER_virtual/libgl = "mesa"
PREFERRED_PROVIDER_virtual/libgles1 = "mesa"
PREFERRED_PROVIDER_virtual/libgles2 = "mesa"
PREFERRED_PROVIDER_virtual/libgbm = "mesa"

GALLIUMDRIVERS:append:pn-mesa = ",panfrost"
PACKAGECONFIG:append:pn-mesa = " egl gles gbm opengl"
```

## meta-axelera/meta-voyager/conf/distro/voyager.conf
```bitbake
# This is an example distro conf. Here is where you can customize the
# policies about how your embedded Linux system should be
# configured. Writing one is so simple that it does not make sense to not
# do it.

DISTRO_NAME = "Voyager Linux"
DISTRO_VERSION = "1.3.3"
SDK_NAME_PREFIX = "voyager"
SDK_VENDOR = "-voyager"
SDK_VERSION := "${@'${DISTRO_VERSION}'.replace('snapshot-${METADATA_REVISION}','snapshot')}"
SDK_VERSION[vardepvalue] = "${SDK_VERSION}"
MAINTAINER = "Amarula Solutions <info@amarulasolutions.com>"
TARGET_VENDOR = "-voyager"

LLVMVERSION = "21.1.8"

# Set features we want on all AXELERA devices. Also disables any features not
# explicitly mentioned.
DISTRO_FEATURES = " \
  egl \
  ipv4 \
  ipv6 \
  egl \
  opencl \
  opengl \
  overlayfs \
  pam \
  seccomp \
  security \
  systemd \
  usbgadget \
  vulkan \
  usbhost \
  virtualization \
  wayland \
  wifi \
  x11 \
  zeroconf \
"

LICENSE_FLAGS_ACCEPTED:append = " commercial"
RUSTVERSION = "1.82.0"
RUST_VERSION = "1.82.0"

require conf/distro/include/mender-config.inc
require conf/distro/include/cve-extra-exclusions.inc
require conf/distro/include/rust_versions.inc

PREFERRED_PROVIDER_virtual/egl = "mesa"
PREFERRED_PROVIDER_virtual/libgl = "mesa"
PREFERRED_PROVIDER_virtual/libgles1 = "mesa"
PREFERRED_PROVIDER_virtual/libgles2 = "mesa"
PREFERRED_PROVIDER_virtual/libgbm = "mesa"
PREFERRED_PROVIDER_virtual/mesa = "mesa"

GALLIUMDRIVERS:append:pn-mesa = ",panfrost"
PACKAGECONFIG:append:pn-mesa = " egl gles gbm opengl opencl panfrost libclc vulkan"
```

## meta-axelera/meta-voyager/conf/layer.conf
```bitbake
# We have a conf and classes directory, add to BBPATH
BBPATH .= ":${LAYERDIR}"

# We have recipes-* directories, add to BBFILES
BBFILES += "${LAYERDIR}/recipes-*/*/*.bb \
            ${LAYERDIR}/recipes-*/*/*.bbappend"

BBFILE_COLLECTIONS += "voyager-layer"
BBFILE_PATTERN_voyager-layer = "^${LAYERDIR}/"
BBFILE_PRIORITY_voyager-layer = "9"

LAYERDEPENDS_voyager-layer = "core"
LAYERSERIES_COMPAT_voyager-layer = "kirkstone"
```
